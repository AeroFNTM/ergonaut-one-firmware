## config/west.yml
```yaml
manifest:
  remotes:
    - name: zmkfirmware
      url-base: https://github.com/zmkfirmware
    - name: ergonautkb
      url-base: https://github.com/ergonautkb
  projects:
   # Inside config/west.yml
    - name: zmk
      remote: zmkfirmware
      revision: main  # or 'v3.5' / a specific updated branch supporting Studio
      import: app/west.yml
    - name: ergonautkb-zmk-module
      remote: ergonautkb
      revision: main
  self:
    path: config
```
